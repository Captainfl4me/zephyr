## boards/shields/st87m01/Kconfig.defconfig
```kconfig
# Copyright (c) 2025 Nicolas THIERRY <nicolas.thierry@estaca.eu>
# SPDX-License-Identifier: Apache-2.0

if SHIELD_ST87M01

if NETWORKING

config MODEM
	default y

config UART_INTERRUPT_DRIVEN
	default y

config MODEM_SHELL
	default y

config MODEM_ST87M01
	default y

# extend retry timing to 20 seconds for LTE/LTE-M
config COAP_INIT_ACK_TIMEOUT_MS
	default 20000

# Hack: disable IPv6 for now
config NET_IPV6
	default n

config NET_CONFIG_NEED_IPV6
	default n

endif # NETWORKING

endif # SHIELD_ST87M01
```

## boards/shields/st87m01/Kconfig.shield
```kconfig
# Copyright (c) 2025 Nicolas THIERRY <nicolas.thierry@estaca.eu>
# SPDX-License-Identifier: Apache-2.0

config SHIELD_ST87M01
	def_bool $(shields_list_contains,shield_st87m01)
```

## drivers/modem/Kconfig.st87m01
```kconfig
# ST87M01 driver options

# Copyright (c) 2025 Nicolas THIERRY <nicolas.thierry@estaca.eu>
# SPDX-License-Identifier: Apache-2.0

config MODEM_ST87M01
	bool "ST87M01 modem driver"
	select MODEM_RECEIVER
	select NET_OFFLOAD
	imply GPIO
	help
	  Choose this setting to enable ST87M01 NB-IoT modem driver.

if MODEM_ST87M01
	config MODEM_ST87M01_INIT_PRIORITY
	int "ST87M01 driver init priority"
	default 80
	help
	  ST87M01 device driver initialization priority.
	  Do not mess with it unless you know what you are doing.
	  Note that the priority needs to be lower than the net stack
	  so that it can start before the networking sub-system.

	config MODEM_ST87M01_MAX_RX_DATA_LENGTH
	int "Size of the receive buffer for the ST87M01 modem"
	default 1024
	help
	  This buffer is used by the ST87M01 RX AT command logic.

	config MODEM_ST87M01_MAX_TX_DATA_LENGTH
	int "Size of the transmit buffer for the ST87M01 modem"
	default 1024
	help
	  This buffer is used by the ST87M01 TX AT command logic.

	config MODEM_ST87M01_RX_STACK_SIZE
	int "Size of the stack for the ST87M01 modem driver RX thread"
	default 1024
	help
	  This stack is used by the ST87M01 RX thread.

	config MODEM_ST87M01_RX_AT_FULL_LOG
	bool "Log all AT command received, even if they do not match any handler"
	default n

endif # MODEM_ST87M01
```

## dts/bindings/modem/st,87m01.yaml
```yaml
# Copyright (c) 2025 Nicolas THIERRY <nicolas.thierry@estaca.eu>
# SPDX-License-Identifier: Apache-2.0

description: ST87M01 NBIoT modem

compatible: "st,87m01"

include: uart-device.yaml

properties:
  mdm-reset-gpios:
    type: phandle-array
    required: true

  mdm-dcdc-gpios:
    type: phandle-array
```
